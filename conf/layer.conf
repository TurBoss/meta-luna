## conf/layer.conf
```bitbake
# We have a conf and classes directory, add to BBPATH
BBPATH .= ":${LAYERDIR}"

# We have recipes-* directories, add to BBFILES
BBFILES += "${LAYERDIR}/recipes-*/*/*.bb \
	${LAYERDIR}/recipes-*/*/*.bbappend"

BBFILE_COLLECTIONS += "luna"
BBFILE_PATTERN_luna = "^${LAYERDIR}/"
BBFILE_PRIORITY_luna = "6"

RF24 = " \
    rf24 \
    rf24-dev \
    rf24mesh \
    rf24mesh-dev \
    rf24network \
    rf24network-dev \
"
GATEWAY = " \
    gateway \
"

IMAGE_INSTALL_append = " ${RF24} ${GATEWAY}"
```
